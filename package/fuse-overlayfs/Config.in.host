## package/fuse-overlayfs/Config.in.host
```kconfig
config BR2_PACKAGE_HOST_FUSE_OVERLAYFS
	bool "host fuse-overlayfs"
	help
	  FUSE-overlayfs is an implementation of overlay+shiftfs in
	  FUSE, intended to be used for rootless containers.

	  http://github.com/containers/fuse-overlayfs
```

## package/generate-ipv6-address/Config.in
```kconfig
config BR2_PACKAGE_GENERATE_IPV6_ADDRESS
	bool "generate-ipv6-address"
	help
	  A simple tool to generate an ipv6 address.

	  https://www.irif.univ-paris-diderot.fr/~jch/software/
```

## package/genuinetools-img/Config.in
```kconfig
config BR2_PACKAGE_GENUINETOOLS_IMG
	bool "genuinetools-img"
	depends on BR2_USE_MMU # fuse-overlayfs libfuse3
	depends on !BR2_STATIC_LIBS # fuse-overlayfs libfuse3
	depends on BR2_TOOLCHAIN_HAS_THREADS # fuse-overlayfs libfuse3
	depends on BR2_TOOLCHAIN_HEADERS_AT_LEAST_3_15 # fuse-overlayfs
	depends on BR2_PACKAGE_HOST_GO_TARGET_ARCH_SUPPORTS
	depends on BR2_PACKAGE_HOST_GO_TARGET_CGO_LINKING_SUPPORTS
	depends on BR2_TOOLCHAIN_HAS_THREADS
	depends on !BR2_TOOLCHAIN_USES_UCLIBC
	select BR2_PACKAGE_CGROUPFS_MOUNT if !BR2_PACKAGE_SYSTEMD # runtime dependency
	select BR2_PACKAGE_FUSE_OVERLAYFS # runtime dependency
	select BR2_PACKAGE_LIBFUSE3 # fuse-overlayfs
	help
	  Img is a standalone, daemon-less, unprivileged Dockerfile
	  and OCI compatible container image builder.

	  https://github.com/genuinetools/img

comment "genuinetools-img needs a toolchain w/ threads, dynamic library, headers >= 3.15"
	depends on BR2_USE_MMU
	depends on !BR2_TOOLCHAIN_HAS_THREADS || BR2_STATIC_LIBS || \
		!BR2_TOOLCHAIN_HEADERS_AT_LEAST_3_15
```

## package/genuinetools-img/Config.in.host
```kconfig
config BR2_PACKAGE_HOST_GENUINETOOLS_IMG
	bool "host genuinetools-img"
	depends on BR2_PACKAGE_HOST_GO_HOST_ARCH_SUPPORTS
	select BR2_PACKAGE_HOST_FUSE_OVERLAYFS # runtime dependency
	help
	  Img is a standalone, daemon-less, unprivileged Dockerfile
	  and OCI compatible container image builder.

	  https://github.com/genuinetools/img
```

## package/git-lfs/Config.in.host
```kconfig
config BR2_PACKAGE_HOST_GIT_LFS
	bool "host git-lfs"
	depends on BR2_PACKAGE_HOST_GO_HOST_ARCH_SUPPORTS
	help
	  Git LFS is a command line extension and specification for
	  managing large files with Git.

	  https://github.com/git-lfs/git-lfs
```

## package/libguestfs/Config.in.host
```kconfig
# TODO: more dependencies
config BR2_PACKAGE_HOST_LIBGUESTFS
	bool "host libguestfs"
	help
	  libguestfs is a library and tool to create disk images

	  https://github.com/libguestfs/libguestfs
```

## package/libocispec/Config.in
```kconfig
config BR2_PACKAGE_LIBOCISPEC
	bool "libocispec"
	select BR2_PACKAGE_YAJL
	help
	  C library for accessing OCI runtime and image spec files.

	  https://github.com/containers/libocispec
```

## package/libyaml/Config.in.host
```kconfig
config BR2_PACKAGE_HOST_LIBYAML
	bool "host libyaml"
	help
	  LibYAML is a YAML 1.1 parser and emitter written in C.
	  Host package.

	  http://pyyaml.org/wiki/LibYAML
```

## package/llvm/Config.in.host
```kconfig
config BR2_PACKAGE_HOST_LLVM
	bool "host llvm"
	depends on BR2_PACKAGE_LLVM_ARCH_SUPPORTS
	depends on BR2_HOST_GCC_AT_LEAST_4_8
	help
	  The LLVM Project is a collection of modular and reusable
	  compiler and toolchain technologies.

	  http://llvm.org

config BR2_PACKAGE_HOST_LLVM_HOST_ARCH
	string
	default "AArch64" if BR2_HOSTARCH="aarch64"
	default "X86" if BR2_HOSTARCH = "x86" || BR2_HOSTARCH = "x86_64"
	default "ARM" if BR2_HOSTARCH = "arm"

config BR2_PACKAGE_HOST_LLVM_ENABLE_HOST_ARCH
	bool
```

## package/meson-tools/Config.in.host
```kconfig
config BR2_PACKAGE_HOST_MESON_TOOLS
	bool "host meson-tools"
	help
	  Tools for Amlogic Meson family of ARM based devices.
	  This includes amlbootsig which can be used to produce signed
	  u-boot images for use with Hardkernel boards.

	  https://github.com/afaerber/meson-tools
```

## package/mkbootimg/Config.in.host
```kconfig
config BR2_PACKAGE_HOST_MKBOOTIMG
	bool "host mkbootimg"
	help
	  Android Bootimg mkbootimg and unpackbootimg utils.
```

## package/nerdctl/Config.in
```kconfig
config BR2_PACKAGE_NERDCTL
	bool "nerdctl"
	depends on BR2_PACKAGE_HOST_GO_TARGET_ARCH_SUPPORTS
	depends on BR2_PACKAGE_HOST_GO_TARGET_CGO_LINKING_SUPPORTS
	depends on BR2_TOOLCHAIN_HAS_THREADS
	depends on !BR2_TOOLCHAIN_USES_UCLIBC # containerd
	depends on BR2_USE_MMU # util-linux
	select BR2_PACKAGE_CONTAINERD # containerd runtime dependency
	select BR2_PACKAGE_RUNC # containerd runtime dependency
	select BR2_PACKAGE_UTIL_LINUX # runtime dependency
	select BR2_PACKAGE_UTIL_LINUX_BINARIES # containerd
	select BR2_PACKAGE_UTIL_LINUX_PIVOT_ROOT # containerd
	select BR2_PACKAGE_UTIL_LINUX_MOUNTPOINT # containerd
	select BR2_PACKAGE_UTIL_LINUX_MOUNT # containerd
	help
	  Docker-compatible CLI for containerd, controlling runc.

	  https://github.com/containerd/nerdctl

comment "nerdctl needs a glibc or musl toolchain w/ threads"
	depends on BR2_PACKAGE_HOST_GO_TARGET_ARCH_SUPPORTS
	depends on BR2_PACKAGE_HOST_GO_TARGET_CGO_LINKING_SUPPORTS
	depends on BR2_USE_MMU
	depends on !BR2_TOOLCHAIN_HAS_THREADS || BR2_TOOLCHAIN_USES_UCLIBC
```

## package/pluginhook/Config.in
```kconfig
config BR2_PACKAGE_PLUGINHOOK
	bool "pluginhook"
	help
		Smart solution to bash script plugin hooks.

		https://github.com/progrium/pluginhook
```

## package/python-pyyaml/Config.in.host
```kconfig
config BR2_PACKAGE_HOST_PYTHON_PYYAML
	bool "host python-pyyaml"
	select BR2_PACKAGE_HOST_LIBYAML
	help
	  The host PyYAML package contains binding to the libyaml API.

	  http://pyyaml.org/
```

## package/rtklib/Config.in
```kconfig
comment "rtklib needs a toolchain w/ threads"
	depends on !BR2_TOOLCHAIN_HAS_THREADS

config BR2_PACKAGE_RTKLIB
	bool "rtklib"
	depends on BR2_TOOLCHAIN_HAS_THREADS
	help
	  RTKLIB is an open source program package for standard and
	  precise positioning with GNSS (global navigation satellite
	  system).

	  This is a version of RTKLIB optimized for single and dual
	  frequency low cost GPS receivers, especially u-blox receivers.

	  https://rtkexplorer.com/

if BR2_PACKAGE_RTKLIB

config BR2_PACKAGE_RTKLIB_CONVBIN
	bool "convbin"

config BR2_PACKAGE_RTKLIB_POS2KML
	bool "pos2kml"

comment "rnx2rtkp needs Fortran"
	depends on !BR2_TOOLCHAIN_HAS_FORTRAN

config BR2_PACKAGE_RTKLIB_RNX2RTKP
	bool "rnx2rtkp"
	depends on BR2_TOOLCHAIN_HAS_FORTRAN

config BR2_PACKAGE_RTKLIB_RTKRCV
	bool "rtkrcv"

config BR2_PACKAGE_RTKLIB_STR2STR
	bool "str2str"

endif
```

## package/rtl8192cu/Config.in
```kconfig
config BR2_PACKAGE_RTL8192CU
	bool "rtl8192cu"
	depends on BR2_LINUX_KERNEL
	help
	  A repackaging of the 8192CU USB WiFi driver
	  with various stability fixes applied.

	  https://github.com/pvaret/rtl8192cu-fixes

comment "rtl8192cu needs a Linux kernel to be built"
	depends on !BR2_LINUX_KERNEL
```

## package/runc/Config.in
```kconfig
config BR2_PACKAGE_RUNC
	bool "runc"
	depends on BR2_PACKAGE_HOST_GO_ARCH_SUPPORTS
	help
    runC is a CLI tool for spawning and running containers
    according to the OCP specification.

	  https://github.com/opencontainers/runc
```

## package/ugetty/Config.in.host
```kconfig
config BR2_PACKAGE_HOST_UGETTY
	bool "host ugetty"
	depends on BR2_TOOLCHAIN_GCC_AT_LEAST_8  # std=c17
	help
	  A minimal getty for embedded Linux that auto-detects the
	  client and dispatches incoming serial connections to a login
	  prompt, a PPP session, or the local SSH server as
	  appropriate.

	  The host package builds only the "proxycommand" binary for
	  use with SSH clients to connect to ugetty over serial.

	  https://github.com/ryancdotorg/ugetty
```

## support/testing/tests/package/br2-external/clang-compiler-rt/package/libfuzzer/Config.in
```kconfig
config BR2_PACKAGE_LIBFUZZER
	bool "libfuzzer"
	help
	  This is a set of tests (benchmarks) for fuzzing
	  engines (fuzzers).

	  https://github.com/google/fuzzer-test-suite
```
