## boot/clover-bin/Config.in
```kconfig
config BR2_TARGET_CLOVER_BIN
	bool "clover-bin"
	depends on BR2_x86_64
	help
	  Clover is a graphical UEFI boot manager.

	  This is the pre-compiled binary variant.

	  https://github.com/CloverHackyColor/CloverBootloader

if BR2_TARGET_CLOVER_BIN

config BR2_TARGET_CLOVER_BIN_INSTALL_FALLBACK
	bool "install Clover as the fallback bootloader"
	help
	  Install Clover as EFI/BOOT/BOOTX64.efi. Do not enable this
	  when another package, such as GRUB, supplies that path.

endif
```

## boot/clover/Config.in
```kconfig
config BR2_TARGET_CLOVER
	bool "clover"
	depends on BR2_x86_64
	depends on BR2_INSTALL_LIBSTDCPP
	depends on !BR2_TARGET_CLOVER_BIN
	help
	  Clover is a graphical UEFI boot manager built from source.

	  https://github.com/CloverHackyColor/CloverBootloader

if BR2_TARGET_CLOVER

config BR2_TARGET_CLOVER_INSTALL_FALLBACK
	bool "install Clover as the fallback bootloader"
	help
	  Install Clover as EFI/BOOT/BOOTX64.efi. Do not enable this
	  when another package, such as GRUB, supplies that path.

endif

comment "clover needs a toolchain w/ C++"
	depends on BR2_x86_64
	depends on !BR2_INSTALL_LIBSTDCPP
	depends on !BR2_TARGET_CLOVER_BIN
```

## package/codex/Config.in
```kconfig
config BR2_PACKAGE_CODEX
	bool "codex"
	depends on BR2_PACKAGE_HOST_RUSTC_TARGET_ARCH_SUPPORTS
	select BR2_PACKAGE_HOST_RUSTC
	select BR2_PACKAGE_LIBCAP
	select BR2_PACKAGE_OPENSSL
	select BR2_PACKAGE_OPENSSL_FORCE_LIBOPENSSL
	help
	  Codex CLI is a coding agent that runs locally in a terminal.

	  https://github.com/openai/codex
```

## package/dbus-forwarding-proxy/Config.in
```kconfig
config BR2_PACKAGE_DBUS_FORWARDING_PROXY
	bool "dbus-forwarding-proxy"
	depends on BR2_USE_WCHAR # libglib2 -> gettext
	depends on BR2_TOOLCHAIN_HAS_THREADS # libglib2, systemd
	depends on BR2_USE_MMU # libglib2, systemd
	depends on !BR2_STATIC_LIBS # systemd
	select BR2_PACKAGE_LIBGLIB2
	select BR2_PACKAGE_SYSTEMD
	help
	  D-Bus forwarding proxy for connecting multiple namespaces.

	  https://github.com/igo95862/dbus-forwarding-proxy

comment "dbus-forwarding-proxy needs a toolchain w/ wchar, threads, dynamic library"
	depends on BR2_USE_MMU
	depends on !BR2_USE_WCHAR || !BR2_TOOLCHAIN_HAS_THREADS || BR2_STATIC_LIBS
```

## toolchain/toolchain-external/toolchain-external-wasi-sdk/Config.in
```kconfig
config BR2_TOOLCHAIN_EXTERNAL_WASI_SDK
	bool "wasi-sdk 30"
	depends on BR2_wasm32
	depends on BR2_HOSTARCH = "x86_64" || BR2_HOSTARCH = "aarch64"
	select BR2_TOOLCHAIN_EXTERNAL_MUSL
	select BR2_TOOLCHAIN_HAS_NO_GDBSERVER
	help
	  wasi-sdk toolchain for WebAssembly (wasm32-wasi) targets.
	  Based on Clang/LLVM with wasi-libc (musl-based).

	  https://github.com/WebAssembly/wasi-sdk
```
