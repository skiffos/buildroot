## package/delve/Config.in
```kconfig
config BR2_PACKAGE_DELVE
	bool "delve"
	depends on BR2_PACKAGE_HOST_GO_TARGET_ARCH_SUPPORTS
	depends on BR2_PACKAGE_HOST_GO_TARGET_CGO_LINKING_SUPPORTS
	depends on BR2_TOOLCHAIN_HAS_THREADS
	depends on BR2_TOOLCHAIN_USES_GLIBC # go, cgo
	depends on !BR2_TOOLCHAIN_USES_UCLIBC # go
	depends on BR2_USE_MMU # go
	help
	  Delve is a debugger for the Go programming language.

	  https://github.com/go-delve/delve

comment "delve needs a glibc toolchain w/ threads"
	depends on BR2_PACKAGE_HOST_GO_TARGET_ARCH_SUPPORTS
	depends on BR2_PACKAGE_HOST_GO_TARGET_CGO_LINKING_SUPPORTS
	depends on !BR2_TOOLCHAIN_HAS_THREADS || !BR2_TOOLCHAIN_USES_GLIBC
	depends on BR2_USE_MMU
```

## package/distrobox/Config.in
```kconfig
config BR2_PACKAGE_DISTROBOX
	bool "distrobox"
	help
	  Tool for containerized distributions with Docker or Podman.

	  https://github.com/89luca89/distrobox
```

## package/docker-cli/Config.in
```kconfig
config BR2_PACKAGE_DOCKER_CLI
	bool "docker-cli"
	depends on BR2_PACKAGE_HOST_GO_ARCH_SUPPORTS
	depends on BR2_PACKAGE_HOST_GO_CGO_LINKING_SUPPORTS
	depends on BR2_TOOLCHAIN_HAS_THREADS
	help
	  Docker is a platform to build, ship,
	  and run applications as lightweight containers.

	  https://github.com/docker/cli

comment "docker-cli needs a toolchain w/ threads"
	depends on BR2_PACKAGE_HOST_GO_ARCH_SUPPORTS
	depends on BR2_PACKAGE_HOST_GO_CGO_LINKING_SUPPORTS
	depends on !BR2_TOOLCHAIN_HAS_THREADS
```

## package/docker-containerd/Config.in
```kconfig
config BR2_PACKAGE_DOCKER_CONTAINERD
	bool "docker-containerd"
	depends on BR2_PACKAGE_HOST_GO_ARCH_SUPPORTS
	depends on BR2_TOOLCHAIN_HAS_THREADS
	depends on BR2_USE_MMU # util-linux
	depends on BR2_USE_WCHAR # util-linux
	select BR2_PACKAGE_RUNC # runc: runtime dependency
	select BR2_PACKAGE_UTIL_LINUX # util-linux: runtime dependency
	select BR2_PACKAGE_UTIL_LINUX_BINARIES # util-linux: runtime dependency
	select BR2_PACKAGE_UTIL_LINUX_PIVOT_ROOT # util-linux: runtime dependency
	select BR2_PACKAGE_UTIL_LINUX_MOUNTPOINT # util-linux: runtime dependency
	select BR2_PACKAGE_UTIL_LINUX_MOUNT # util-linux: runtime dependency
	help
	  containerd is a daemon to control runC.

	  https://github.com/docker/containerd

comment "docker-containerd needs a toolchain w/ threads"
	depends on BR2_PACKAGE_HOST_GO_ARCH_SUPPORTS
	depends on !BR2_TOOLCHAIN_HAS_THREADS
```

## package/docker-engine/Config.in
```kconfig
config BR2_PACKAGE_DOCKER_ENGINE
	bool "docker-engine"
	depends on BR2_PACKAGE_HOST_GO_ARCH_SUPPORTS
	depends on BR2_TOOLCHAIN_HAS_THREADS
	depends on BR2_USE_MMU # util-linux
	depends on BR2_USE_WCHAR # util-linux
	select BR2_PACKAGE_DOCKER_CONTAINERD
	select BR2_PACKAGE_RUNC
	select BR2_PACKAGE_SQLITE
	select BR2_PACKAGE_UTIL_LINUX
	select BR2_PACKAGE_UTIL_LINUX_BINARIES
	select BR2_PACKAGE_UTIL_LINUX_PIVOT_ROOT
	select BR2_PACKAGE_UTIL_LINUX_MOUNTPOINT
	select BR2_PACKAGE_UTIL_LINUX_MOUNT
	help
	  Docker is a platform to build, ship,
	  and run applications as lightweight containers.

	  https://github.com/docker/docker

comment "docker-engine needs a toolchain w/ threads"
	depends on BR2_PACKAGE_HOST_GO_ARCH_SUPPORTS
	depends on !BR2_TOOLCHAIN_HAS_THREADS

if BR2_PACKAGE_DOCKER_ENGINE

config BR2_PACKAGE_DOCKER_ENGINE_DAEMON
	bool "docker daemon"
	default y
	help
	  Build the Docker system daemon.
	  If not selected, will build client only.

config BR2_PACKAGE_DOCKER_ENGINE_EXPERIMENTAL
	bool "build experimental features"

if BR2_PACKAGE_DOCKER_ENGINE_DAEMON

config BR2_PACKAGE_DOCKER_ENGINE_DRIVER_BTRFS
	bool "btrfs filesystem driver"
	depends on BR2_USE_WCHAR # btrfs-progs
	depends on BR2_USE_MMU # btrfs-progs
	depends on BR2_TOOLCHAIN_HAS_THREADS # btrfs-progs
	select BR2_PACKAGE_BTRFS_PROGS
	help
	  Build the btrfs filesystem driver for Docker.

config BR2_PACKAGE_DOCKER_ENGINE_DRIVER_DEVICEMAPPER
	bool "devicemapper filesystem driver"
	depends on BR2_TOOLCHAIN_HAS_THREADS # lvm2
	depends on BR2_USE_MMU # lvm2
	depends on !BR2_STATIC_LIBS # lvm2
	select BR2_PACKAGE_LVM2
	select BR2_PACKAGE_LVM2_APP_LIBRARY
	help
	  Build the devicemapper filesystem driver for Docker.

config BR2_PACKAGE_DOCKER_ENGINE_DRIVER_VFS
	bool "vfs filesystem driver"
	depends on BR2_USE_WCHAR # gvfs
	depends on BR2_USE_MMU # gvfs
	depends on BR2_TOOLCHAIN_HAS_THREADS # gvfs
	select BR2_PACKAGE_GVFS
	help
	  Build the vfs filesystem driver for Docker.

endif
```

## package/dumb-init/Config.in
```kconfig
config BR2_PACKAGE_DUMB_INIT
	bool "dumb-init"
	help
	  dumb-init is a simple but valid init binary to
	  act as PID 1 for containers.

	  https://github.com/Yelp/dumb-init
```

## package/embiggen-disk/Config.in
```kconfig
config BR2_PACKAGE_EMBIGGEN_DISK
	bool "embiggen-disk"
	depends on BR2_PACKAGE_HOST_GO_TARGET_ARCH_SUPPORTS
	depends on BR2_PACKAGE_HOST_GO_TARGET_CGO_LINKING_SUPPORTS
	depends on BR2_TOOLCHAIN_HAS_THREADS
	depends on !BR2_TOOLCHAIN_USES_UCLIBC # no fexecve
	select BR2_PACKAGE_UTIL_LINUX # sfdisk
	select BR2_PACKAGE_UTIL_LINUX_BINARIES # sfdisk
	help
	  embiggen-disk is a tool to resize disk partitions at runtime.

	  https://github.com/bradfitz/embiggen-disk

comment "embiggen-disk needs a glibc or musl toolchain w/ threads"
	depends on BR2_PACKAGE_HOST_GO_TARGET_ARCH_SUPPORTS && \
		BR2_PACKAGE_HOST_GO_TARGET_CGO_LINKING_SUPPORTS
	depends on !BR2_TOOLCHAIN_HAS_THREADS || BR2_TOOLCHAN_USES_UCLIBC
```
