## .github/workflows/buildroot-e2e_defconfig
```kconfig
BR2_x86_64=y
BR2_x86_core_avx2=y
BR2_CCACHE=y
BR2_OPTIMIZE_FAST=y
BR2_TOOLCHAIN_BUILDROOT_GLIBC=y
BR2_TOOLCHAIN_BUILDROOT_CXX=y
BR2_GCC_ENABLE_LTO=n
BR2_INIT_SYSTEMD=y
# BR2_TARGET_ENABLE_ROOT_LOGIN is not set
BR2_SYSTEM_BIN_SH_BASH=y
BR2_ENABLE_LOCALE_WHITELIST="C en_US en_US.UTF-8"
BR2_GENERATE_LOCALE="en_US.UTF-8"
BR2_LINUX_KERNEL=y
BR2_LINUX_KERNEL_DEFCONFIG="x86_64"
BR2_LINUX_KERNEL_NEEDS_HOST_OPENSSL=y
BR2_PACKAGE_CA_CERTIFICATES=y
BR2_PACKAGE_DELVE=y
BR2_PACKAGE_DOCKER_CLI=y
BR2_PACKAGE_DOCKER_CLI_STATIC=y
BR2_PACKAGE_DOCKER_ENGINE_EXPERIMENTAL=y
BR2_PACKAGE_MENDER=y
BR2_PACKAGE_HOST_MENDER_ARTIFACT=y
```

## boot/refind-bin/Config.in
```kconfig
config BR2_PACKAGE_REFIND_BIN_ARCH_SUPPORTS
	bool
	default y if BR2_i386
	default y if BR2_x86_64
	default y if BR2_aarch64
	depends on BR2_USE_MMU

menuconfig BR2_TARGET_REFIND_BIN
	bool "refind-bin"
	depends on BR2_PACKAGE_REFIND_BIN_ARCH_SUPPORTS
	help
	  rEFInd presents a user-friendly GUI for boot selection.

	  For additional notes on using rEFInd with Buildroot, see
	  boot/refind/readme.txt

	  This is the pre-compiled binary variant.

	  https://www.rodsbooks.com/refind/

if BR2_TARGET_REFIND_BIN

config BR2_TARGET_REFIND_BIN_RENAME_TO_BOOT
	bool "rename refind efi files to BOOT"
	help
	  Move refind EFI directory to the default BOOT path.

endif
```

## boot/refind/Config.in
```kconfig
config BR2_PACKAGE_REFIND_ARCH_SUPPORTS
	bool
	default y if BR2_i386
	default y if BR2_x86_64
	default y if BR2_aarch64
	depends on BR2_USE_MMU

config BR2_TARGET_REFIND
	bool "refind"
	depends on BR2_PACKAGE_REFIND_ARCH_SUPPORTS
	select BR2_PACKAGE_GNU_EFI
	help
	  rEFInd presents a user-friendly GUI for boot selection.

	  For additional notes on using rEFInd with Buildroot, see
	  boot/refind/readme.txt

	  https://www.rodsbooks.com/refind/
```

## configs/jetsonnano_defconfig
```kconfig
BR2_aarch64=y
BR2_cortex_a57=y
BR2_ARM_FPU_FP_ARMV8=y

# enable specific optimizations
BR2_TARGET_OPTIMIZATION="-march=armv8-a+crypto -mcpu=cortex-a57+crypto"

# Toolchain reference: docs.nvidia.com: "Jetson Linux Driver Package Toolchain"
# https://developer.nvidia.com/gcc-linaro-731-201805-sources
BR2_TOOLCHAIN_EXTERNAL_LINARO_AARCH64=y

BR2_SYSTEM_DHCP="eth0"

BR2_LINUX_KERNEL=y
BR2_LINUX_KERNEL_CUSTOM_TARBALL=y
# patches-l4t-r32.4
BR2_LINUX_KERNEL_CUSTOM_TARBALL_LOCATION="$(call github,madisongh,linux-tegra-4.9,0be1a57448010ae60505acf4e2153638455cee7c)/linux-tegra-4.9.140-r1.tar.gz"
BR2_LINUX_KERNEL_DEFCONFIG="tegra"

# Build the DTB from the kernel sources
BR2_LINUX_KERNEL_DTS_SUPPORT=y
BR2_LINUX_KERNEL_INTREE_DTS_NAME="_ddot_/_ddot_/_ddot_/_ddot_/nvidia/platform/t210/porg/kernel-dts/tegra210-p3448-0000-p3449-0000-a02 _ddot_/_ddot_/_ddot_/_ddot_/nvidia/platform/t210/porg/kernel-dts/tegra210-p3448-0000-p3449-0000-b00"

BR2_LINUX_KERNEL_NEEDS_HOST_OPENSSL=y

BR2_PACKAGE_LINUX4TEGRA=y
BR2_PACKAGE_LINUX4TEGRA_PLATFORM_T210REF=y

# TODO: NVIDIA_CONTAINER_TOOLKIT requires a go-module integration.
# BR2_PACKAGE_NVIDIA_CONTAINER_TOOLKIT=y

BR2_PACKAGE_LINUX_FIRMWARE=y
BR2_PACKAGE_LINUX_FIRMWARE_RTL_88XX=y

# Required tools to create the image
BR2_PACKAGE_HOST_DOSFSTOOLS=y
BR2_PACKAGE_HOST_JQ=y
BR2_PACKAGE_HOST_PARTED=y

# Filesystem / image
BR2_TARGET_ROOTFS_EXT2=y
BR2_TARGET_ROOTFS_EXT2_4=y
BR2_TARGET_ROOTFS_EXT2_SIZE="512M"
# BR2_TARGET_ROOTFS_TAR is not set

# Uboot
BR2_TARGET_UBOOT=y
BR2_TARGET_UBOOT_BOARD_DEFCONFIG="p3450-porg"
BR2_TARGET_UBOOT_BUILD_SYSTEM_KCONFIG=y
BR2_TARGET_UBOOT_CUSTOM_TARBALL=y
BR2_TARGET_UBOOT_CUSTOM_TARBALL_LOCATION="$(call github,paralin,u-boot-tegra,45dfa3dff43f880243a9fe68f3d911e99a240654)/u-boot-tegra-l4t-r32.4.2-v2016.07.tar.gz"
BR2_TARGET_UBOOT_FORMAT_DTB_BIN=y
BR2_TARGET_UBOOT_NEEDS_DTC=y
```

## configs/jetsontx2_defconfig
```kconfig
BR2_aarch64=y
BR2_cortex_a57=y
BR2_ARM_FPU_FP_ARMV8=y

# enable specific optimizations
BR2_TARGET_OPTIMIZATION="-march=armv8-a+crypto -mcpu=cortex-a57+crypto"

# Toolchain reference: docs.nvidia.com: "Jetson Linux Driver Package Toolchain"
# https://developer.nvidia.com/gcc-linaro-731-201805-sources
BR2_TOOLCHAIN_EXTERNAL_LINARO_AARCH64=y

BR2_SYSTEM_DHCP="eth0"

BR2_LINUX_KERNEL=y
BR2_LINUX_KERNEL_CUSTOM_TARBALL=y
# patches-l4t-r32.4
BR2_LINUX_KERNEL_CUSTOM_TARBALL_LOCATION="$(call github,madisongh,linux-tegra-4.9,0be1a57448010ae60505acf4e2153638455cee7c)/linux-tegra-4.9.140-r1.tar.gz"
BR2_LINUX_KERNEL_DEFCONFIG="tegra"

# Build the DTB from the kernel sources
BR2_LINUX_KERNEL_DTS_SUPPORT=y
BR2_LINUX_KERNEL_INTREE_DTS_NAME="_ddot_/_ddot_/_ddot_/_ddot_/nvidia/platform/t18x/quill/kernel-dts/tegra186-quill-p3310-1000-c03-00-base"

BR2_LINUX_KERNEL_NEEDS_HOST_OPENSSL=y

BR2_PACKAGE_LINUX4TEGRA=y
BR2_PACKAGE_LINUX4TEGRA_PLATFORM_T186REF=y

# TODO: NVIDIA_CONTAINER_TOOLKIT requires a go-module integration.
# BR2_PACKAGE_NVIDIA_CONTAINER_TOOLKIT=y

BR2_PACKAGE_LINUX_FIRMWARE=y
BR2_PACKAGE_LINUX_FIRMWARE_RTL_88XX=y

# Required tools to create the image
BR2_PACKAGE_HOST_DOSFSTOOLS=y
BR2_PACKAGE_HOST_JQ=y
BR2_PACKAGE_HOST_PARTED=y

# Filesystem / image
BR2_TARGET_ROOTFS_EXT2=y
BR2_TARGET_ROOTFS_EXT2_4=y
BR2_TARGET_ROOTFS_EXT2_SIZE="512M"
# BR2_TARGET_ROOTFS_TAR is not set

# Uboot
BR2_TARGET_UBOOT=y
BR2_TARGET_UBOOT_BOARD_DEFCONFIG="p2771-0000-500"
BR2_TARGET_UBOOT_BUILD_SYSTEM_KCONFIG=y
BR2_TARGET_UBOOT_CUSTOM_TARBALL=y
BR2_TARGET_UBOOT_CUSTOM_TARBALL_LOCATION="$(call github,paralin,u-boot-tegra,e6da093be3cc593ef4294e1922b3391ede9c94da)/u-boot-tegra-l4t-r32.4-v2016.7.tar.gz"
BR2_TARGET_UBOOT_FORMAT_DTB_BIN=y
BR2_TARGET_UBOOT_NEEDS_DTC=y
```

## package/amlogic-boot-fip/Config.in.host
```kconfig
config BR2_PACKAGE_HOST_AMLOGIC_BOOT_FIP
	bool "host amlogic-boot-fip"
	help
	  Firmware Image Package (FIP) sources used to sign Amlogic
	  u-boot binaries in LibreELEC images

	  https://gitlab.com/LibreELEC/amlogic-boot-fip

if BR2_PACKAGE_HOST_AMLOGIC_BOOT_FIP

config BR2_PACKAGE_HOST_AMLOGIC_BOOT_FIP_DEVICE
	string "fip device"
	default "khadas-vim3"
	depends on BR2_PACKAGE_HOST_AMLOGIC_BOOT_FIP
	help
	  Device for which you want to use this package.
	  See the list of supported SoCs:
	  https://github.com/LibreELEC/amlogic-boot-fip

endif # BR2_PACKAGE_HOST_AMLOGIC_BOOT_FIP
```

## package/aufs-standalone/Config.in
```kconfig
config BR2_PACKAGE_AUFS_STANDALONE
	bool
	depends on BR2_USE_MMU
	depends on BR2_TOOLCHAIN_HAS_THREADS
	depends on BR2_LINUX_KERNEL
```

## package/aufs-util/Config.in
```kconfig
config BR2_PACKAGE_AUFS_UTIL
	bool "aufs-util"
	depends on BR2_USE_MMU
	depends on BR2_TOOLCHAIN_HAS_THREADS
	depends on BR2_LINUX_KERNEL
	help
	  Aufs command line utilities.
	  Needs a kernel with aufs support. A kernel
	  extension package is available.

	  http://sourceforge.net/p/aufs/aufs-util/

# While we don't build from the kernel headers
# we can get a default value here
config BR2_PACKAGE_AUFS_UTIL_VERSION
	string "aufs-util branch"
	depends on BR2_PACKAGE_AUFS_UTIL
	help
	  Aufs-util repository branch to use. Must match kernel version.
	default "3.0"  if BR2_KERNEL_HEADERS_3_0
	default "3.2"  if BR2_KERNEL_HEADERS_3_2
	default "3.2"  if BR2_KERNEL_HEADERS_3_4
	default "3.9"  if BR2_KERNEL_HEADERS_3_10 || BR2_KERNEL_HEADERS_3_11 || BR2_KERNEL_HEADERS_3_12 || BR2_KERNEL_HEADERS_3_13
	default "3.14" if BR2_KERNEL_HEADERS_3_14 || BR2_KERNEL_HEADERS_3_15 || BR2_KERNEL_HEADERS_3_16 || BR2_KERNEL_HEADERS_3_17 || BR2_KERNEL_HEADERS_3_18 || BR2_KERNEL_HEADERS_3_19
	default "4.0"  if BR2_KERNEL_HEADERS_4_0 || BR2_KERNEL_HEADERS_4_1

comment "aufs-util needs a linux kernel"
	depends on BR2_USE_MMU
	depends on !BR2_LINUX_KERNEL

comment "aufs-util needs a toolchain w/ threads"
	depends on BR2_USE_MMU
	depends on BR2_LINUX_KERNEL
	depends on !BR2_TOOLCHAIN_HAS_THREADS
```

## package/babeld/Config.in
```kconfig
config BR2_PACKAGE_BABELD
	bool "babeld"
	help
	  Babel is a loop-avoiding distance-vector routing protocol for IPv6 and
	  IPv4 with fast convergence properties. It is based on the ideas in DSDV,
	  AODV and Cisco's EIGRP, but is designed to work well not only in wired
	  networks but also in wireless mesh networks, and has been extended with
	  support for overlay networks.

	  https://www.irif.univ-paris-diderot.fr/~jch/software/babel/
```

## package/buildah/Config.in
```kconfig
config BR2_PACKAGE_BUILDAH
	bool "buildah"
	depends on BR2_PACKAGE_HOST_GO_TARGET_ARCH_SUPPORTS
	depends on BR2_PACKAGE_HOST_GO_TARGET_CGO_LINKING_SUPPORTS
	depends on BR2_PACKAGE_LIBGPG_ERROR_ARCH_SUPPORTS # libgpgme -> libgpg-error
	depends on BR2_TOOLCHAIN_HAS_THREADS
	depends on BR2_USE_MMU # libgpgme -> libassuan
	# gnupg is not needed to build, but at runtime.
	select BR2_PACKAGE_LIBGPGME
	select BR2_PACKAGE_GNUPG if !BR2_PACKAGE_GNUPG2
	select BR2_PACKAGE_LIBGPG_ERROR
	select BR2_PACKAGE_LIBASSUAN
	help
	  Buildah is a tool that facilitates building OCI images.

	  https://github.com/containers/buildah

comment "buildah needs a toolchain w/ threads"
	depends on BR2_PACKAGE_HOST_GO_TARGET_ARCH_SUPPORTS
	depends on BR2_PACKAGE_HOST_GO_TARGET_CGO_LINKING_SUPPORTS
	depends on !BR2_TOOLCHAIN_HAS_THREADS
```

## package/buildah/Config.in.host
```kconfig
config BR2_PACKAGE_HOST_BUILDAH
	bool "host buildah"
	depends on BR2_PACKAGE_HOST_GO_HOST_ARCH_SUPPORTS
	select BR2_PACKAGE_HOST_RUNC
	help
	  Buildah is a tool that facilitates building OCI images.

	  https://github.com/containers/buildah
```

## package/catatonit/Config.in
```kconfig
config BR2_PACKAGE_CATATONIT
	bool "catatonit"
	help
	  catatonit is a simple but valid init binary to act as
	  PID 1 for containers.

	  https://github.com/openSUSE/catatonit
```

## package/chromium/Config.in
```kconfig
config BR2_PACKAGE_CHROMIUM_ARCH_SUPPORTS
	bool
	default y if BR2_arm
	default y if BR2_aarch64
	default y if BR2_i386
	default y if BR2_x86_64

config BR2_PACKAGE_CHROMIUM_TARGET_ARCH
	string
	default "arm" if BR2_arm
	default "arm64" if BR2_aarch64
	default "x86" if BR2_i386
	default "x64" if BR2_x86_64

menuconfig BR2_PACKAGE_CHROMIUM
	bool "chromium"
	depends on BR2_HOST_GCC_AT_LEAST_4_9 # gn requires -std=c++14
	depends on BR2_INSTALL_LIBSTDCPP # icu
	depends on BR2_USE_WCHAR # icu
	depends on BR2_PACKAGE_HAS_LIBGL
	depends on BR2_PACKAGE_XORG7
	depends on BR2_TOOLCHAIN_GCC_AT_LEAST_4_8 # icu
	depends on BR2_TOOLCHAIN_USES_GLIBC
	depends on BR2_TOOLCHAIN_HAS_THREADS # icu
	depends on !BR2_BINFMT_FLAT # icu
	select BR2_PACKAGE_AT_SPI2_ATK
	select BR2_PACKAGE_ALSA_LIB
	select BR2_PACKAGE_COMPILER_RT
	select BR2_PACKAGE_FFMPEG
	select BR2_PACKAGE_FLAC
	select BR2_PACKAGE_FREETYPE
	select BR2_PACKAGE_FONTCONFIG
	select BR2_PACKAGE_HARFBUZZ
	select BR2_PACKAGE_HOST_CLANG
	select BR2_PACKAGE_HOST_ICU
	select BR2_PACKAGE_HOST_LLD
	select BR2_PACKAGE_HOST_NINJA
	select BR2_PACKAGE_HOST_NODEJS
	select BR2_PACKAGE_HOST_PKGCONF
	select BR2_PACKAGE_HOST_PYTHON
	select BR2_PACKAGE_ICU
	select BR2_PACKAGE_JPEG_TURBO
	select BR2_PACKAGE_LIBDRM
	select BR2_PACKAGE_LIBERATION # runtime
	select BR2_PACKAGE_LIBGLIB2
	select BR2_PACKAGE_LIBKRB5
	select BR2_PACKAGE_LIBNSS
	select BR2_PACKAGE_LIBPNG
	select BR2_PACKAGE_LIBXML2
	select BR2_PACKAGE_LIBXSLT
	select BR2_PACKAGE_MINIZIP
	select BR2_PACKAGE_NCURSES
	select BR2_PACKAGE_NCURSES_WCHAR
	select BR2_PACKAGE_OPUS
	select BR2_PACKAGE_PANGO
	select BR2_PACKAGE_SNAPPY
	select BR2_PACKAGE_WEBP
	select BR2_PACKAGE_WEBP_MUX
	select BR2_PACKAGE_WEBP_DEMUX
	select BR2_PACKAGE_XLIB_LIBXCOMPOSITE
	select BR2_PACKAGE_XLIB_LIBXCURSOR
	select BR2_PACKAGE_XLIB_LIBXI if !BR2_PACKAGE_LIBGTK3_X11
	select BR2_PACKAGE_XLIB_LIBXRANDR
	select BR2_PACKAGE_XLIB_LIBXSCRNSAVER
	select BR2_PACKAGE_XLIB_LIBXTST if !BR2_PACKAGE_LIBGTK3_X11
	select BR2_PACKAGE_LIBGTK3
	help
	  Chromium is an open-source Web browser project started by
	  Google, to provide the source code for the proprietary
	  Google Chrome browser.

if BR2_PACKAGE_CHROMIUM

config BR2_PACKAGE_CHROMIUM_PROPRIETARY_CODECS
	bool "Enable proprietary codecs"
	help
	  Enables proprietary codecs with additional licensing
	  restrictions, such as MP3 and H264

endif # BR2_PACKAGE_CHROMIUM

comment "chromium needs toolchain w/ Glibc, host gcc >= 4.9.0, dynamic library"
	depends on BR2_PACKAGE_CHROMIUM_ARCH_SUPPORTS \
		&& !BR2_TOOLCHAIN_USES_GLIBC \
		|| !BR2_HOST_GCC_AT_LEAST_4_9

comment "chromium needs X.org and an OpenGL backend"
	depends on BR2_PACKAGE_CHROMIUM_ARCH_SUPPORTS \
		&& !BR2_PACKAGE_XORG7 \
		|| !BR2_PACKAGE_HAS_LIBGL
```

## package/conmon/Config.in
```kconfig
config BR2_PACKAGE_CONMON
	bool "conmon"
	depends on BR2_TOOLCHAIN_HAS_THREADS
	depends on !BR2_TOOLCHAIN_USES_UCLIBC # no fexecve
	help
	  Conmon is an OCI container runtime monitor.

	  https://github.com/containers/conmon

comment "conmon needs a glibc or musl toolchain w/ threads"
	depends on !BR2_TOOLCHAIN_HAS_THREADS || BR2_TOOLCHAIN_USES_UCLIBC
```

## package/containers-toolbox/Config.in
```kconfig
config BR2_PACKAGE_CONTAINERS_TOOLBOX
	bool "containers-toolbox"
	depends on BR2_PACKAGE_HOST_GO_TARGET_ARCH_SUPPORTS # podman
	depends on BR2_PACKAGE_HOST_GO_TARGET_CGO_LINKING_SUPPORTS # podman
	depends on BR2_TOOLCHAIN_HAS_THREADS # podman
	depends on !BR2_TOOLCHAIN_USES_UCLIBC # podman
	depends on BR2_USE_MMU # podman
	select BR2_PACKAGE_PODMAN
	help
	  Tool for containerized command line environments with Podman.

	  https://containertoolbx.org

comment "containers-toolbox needs a glibc or musl toolchain w/ threads"
	depends on BR2_PACKAGE_HOST_GO_TARGET_ARCH_SUPPORTS && \
		BR2_PACKAGE_HOST_GO_TARGET_CGO_LINKING_SUPPORTS
	depends on !BR2_TOOLCHAIN_HAS_THREADS || BR2_TOOLCHAIN_USES_UCLIBC
```

## package/crew/Config.in
```kconfig
config BR2_PACKAGE_CREW
	bool "crew"
	select BR2_PACKAGE_DOCKER_ENGINE
	select BR2_PACKAGE_PERL
	select BR2_PACKAGE_CURL
	help
	  Container manager for docker.

	  https://github.com/paralin/crew
```

## package/crio/Config.in
```kconfig
config BR2_PACKAGE_CRIO
	bool "crio"
	depends on BR2_PACKAGE_HOST_GO_TARGET_ARCH_SUPPORTS
	depends on BR2_PACKAGE_HOST_GO_TARGET_CGO_LINKING_SUPPORTS
	depends on BR2_TOOLCHAIN_HAS_THREADS
	depends on BR2_TOOLCHAIN_HEADERS_AT_LEAST_3_4 # iproute2, __kernel_{u,}long_t
	depends on !BR2_TOOLCHAIN_USES_UCLIBC # no fexecve
	depends on BR2_USE_MMU # libgpgme, iproute2, fork()
	select BR2_PACKAGE_IPROUTE2
	select BR2_PACKAGE_IPTABLES
	select BR2_PACKAGE_LIBGPGME
	help
	  crio implements the Kubelet Container Runtime Interface (CRI)
	  using OCI conformant runtimes like runc or podman.

	  https://github.com/cri-o/cri-o/

if BR2_PACKAGE_CRIO

config BR2_PACKAGE_CRIO_DRIVER_BTRFS
	bool "btrfs filesystem driver"
	depends on BR2_USE_MMU # btrfs-progs
	depends on BR2_TOOLCHAIN_HAS_THREADS # btrfs-progs
	select BR2_PACKAGE_BTRFS_PROGS
	help
	  Build the btrfs filesystem driver.

config BR2_PACKAGE_CRIO_DRIVER_DEVICEMAPPER
	bool "devicemapper filesystem driver"
	depends on BR2_TOOLCHAIN_HAS_THREADS # lvm2
	depends on BR2_USE_MMU # lvm2
	depends on !BR2_STATIC_LIBS # lvm2
	select BR2_PACKAGE_LVM2
	help
	  Build the devicemapper filesystem driver.

config BR2_PACKAGE_CRIO_DRIVER_OSTREE
	bool "ostree storage driver"
	depends on BR2_PACKAGE_LIBGPG_ERROR_ARCH_SUPPORTS # libostree, libgpgme, libgpg-error
	depends on BR2_TOOLCHAIN_HAS_THREADS # libostree, libglib2
	depends on BR2_USE_WCHAR # libostree, libglib2
	depends on BR2_USE_MMU # libostree, e2fsprogs, libglib2, libgpgme
	# doesn't build with musl due to lack of TEMP_FAILURE_RETRY()
	depends on !BR2_TOOLCHAIN_USES_MUSL # libostree
	select BR2_PACKAGE_LIBOSTREE
	help
	  Build the ostree storage driver.

endif

comment "crio needs a glibc or musl toolchain w/ threads"
	depends on BR2_PACKAGE_HOST_GO_TARGET_ARCH_SUPPORTS && \
		BR2_PACKAGE_HOST_GO_TARGET_CGO_LINKING_SUPPORTS
	depends on !BR2_TOOLCHAIN_HAS_THREADS || BR2_TOOLCHAIN_USES_UCLIBC
```

## package/daemonize/Config.in
```kconfig
menuconfig BR2_PACKAGE_DAEMONIZE
	bool "daemonize"
	help
	  Command line utility to run a daemon.
```
